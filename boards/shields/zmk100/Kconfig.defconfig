## boards/shields/zmk100/Kconfig.defconfig
```kconfig
# Copyright (c) 2023 The ZMK Contributors
# SPDX-License-Identifier: MIT

if SHIELD_ZMK100_LEFT

config ZMK_SPLIT_ROLE_CENTRAL
    def_bool y

endif

if SHIELD_ZMK100_RIGHT

config ZMK_SPLIT_ROLE_PERIPHERAL
    def_bool y

endif

if SHIELD_ZMK100_LEFT || SHIELD_ZMK100_RIGHT

config ZMK_SPLIT
    default y

config ZMK_RGB_UNDERGLOW
    select WS2812_STRIP
    select SPI

if ZMK_DISPLAY

config SSD1306
    default y

config I2C
    default y

endif # ZMK_DISPLAY

if LVGL

config LV_Z_VDB_SIZE
    default 64

config LV_DPI_DEF
    default 148

config LV_Z_BITS_PER_PIXEL
    default 1

choice LV_COLOR_DEPTH
    default LV_COLOR_DEPTH_1
endchoice

endif # LVGL

endif # SHIELD_ZMK100_LEFT || SHIELD_ZMK100_RIGHT
```

## boards/shields/zmk100/Kconfig.shield
```kconfig
config SHIELD_ZMK100_LEFT
    def_bool $(shields_list_contains,zmk100_left)

config SHIELD_ZMK100_RIGHT
    def_bool $(shields_list_contains,zmk100_right)
```
