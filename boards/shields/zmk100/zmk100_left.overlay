#include "zmk100.dtsi"

 / {
     chosen {
         zmk,split-role = "central";
         zmk,kscan = &kscan0;
         zmk,matrix-transform = &default_transform;
         zephyr,display = &oled;
     };
 };

 &kscan0 {
     col-gpios
         = <&gpio0 3 GPIO_ACTIVE_HIGH>
         , <&gpio0 28 GPIO_ACTIVE_HIGH>
         , <&gpio0 30 GPIO_ACTIVE_HIGH>
         , <&gpio0 21 GPIO_ACTIVE_HIGH>
         , <&gpio0 23 GPIO_ACTIVE_HIGH>
         , <&gpio0 22 GPIO_ACTIVE_HIGH>
         ;
 };

 &left_encoder {
     status = "okay";
 };